## CMakeLists.txt
```
cmake_minimum_required(VERSION 3.20.0)
find_package(Zephyr REQUIRED HINTS $ENV{ZEPHYR_BASE})
project(smartlock)
target_sources(app PRIVATE src/main.c src/lock_service.c src/motor.c src/storage.c)
```

## prj.conf
```kconfig
CONFIG_BT=y
CONFIG_BT_PERIPHERAL=y
CONFIG_BT_DEVICE_NAME="AcmeLock"
CONFIG_BT_SMP=y
CONFIG_BT_FIXED_PASSKEY=y
CONFIG_BT_GATT_DYNAMIC_DB=n

CONFIG_SETTINGS=y
CONFIG_BT_SETTINGS=y
CONFIG_FLASH=y
CONFIG_FLASH_MAP=y
CONFIG_NVS=y

CONFIG_LOG=y
CONFIG_LOG_DEFAULT_LEVEL=4
CONFIG_SHELL=y
CONFIG_SHELL_BACKEND_SERIAL=y

CONFIG_GPIO=y
CONFIG_ASSERT=n
CONFIG_RESET_ON_FATAL_ERROR=n

CONFIG_BOOTLOADER_MCUBOOT=y
CONFIG_MCUBOOT_SIGNATURE_KEY_FILE="bootloader/mcuboot/root-ec-p256.pem"
```

## src/main.c
```c
#include <zephyr/kernel.h>
#include <zephyr/logging/log.h>
#include <zephyr/bluetooth/bluetooth.h>
#include "lock.h"

LOG_MODULE_REGISTER(main, LOG_LEVEL_DBG);

#define FW_VERSION "0.9.1"
#define AUTO_RELOCK_MS 10000

extern uint32_t g_unlocked_at;
extern bool g_unlocked;

int main(void)
{
    LOG_INF("AcmeLock %s", FW_VERSION);
    storage_init();
    motor_init();

    if (bt_enable(NULL)) {
        LOG_ERR("bt_enable failed");
        while (1) { }
    }
    bt_passkey_set(123456);
    lock_service_init();

    while (1) {
        /* auto relock */
        if (g_unlocked && k_uptime_get_32() > g_unlocked_at + AUTO_RELOCK_MS && !g_door_open) {
            motor_lock();
            g_unlocked = false;
        }
        k_msleep(100);
    }
    return 0;
}
```

## src/storage.c
```c
#include <string.h>
#include <zephyr/kernel.h>
#include <zephyr/settings/settings.h>
#include <zephyr/logging/log.h>
#include "lock.h"

LOG_MODULE_REGISTER(storage, LOG_LEVEL_DBG);

static uint8_t *load_dst;
static uint8_t *load_len;

static int lock_set(const char *name, size_t len, settings_read_cb read_cb, void *cb_arg)
{
    if (!strcmp(name, "code")) {
        *load_len = (uint8_t)read_cb(cb_arg, load_dst, len);
        LOG_INF("loaded code %.*s", *load_len, load_dst);
    }
    return 0;
}

SETTINGS_STATIC_HANDLER_DEFINE(lock, "lock", NULL, lock_set, NULL, NULL);

int storage_init(void)
{
    settings_subsys_init();
    return 0;
}

int storage_load_code(uint8_t *code, uint8_t *len)
{
    load_dst = code;
    load_len = len;
    return settings_load_subtree("lock");
}

int storage_save_code(const uint8_t *code, uint8_t len)
{
    settings_save_one("lock/code", code, len);
    return 0;
}
```
