## .claude/skills/firmware-review/evals/zephyr-ble-lock-audit/files/smartlock-fw/west.yml
```yaml
manifest:
  remotes:
    - name: ncs
      url-base: https://github.com/nrfconnect
  projects:
    - name: sdk-nrf
      remote: ncs
      path: nrf
      revision: main
      import: true
  self:
    path: app
```
